#include "zmk-helpers/key-labels/glove80.h"

#define COMBO_TERM_FAST 18
#define COMBO_TERM_SLOW 30

#define COMBO_IDLE_FAST 150
#define COMBO_IDLE_SLOW 50

// Combos
//ZMK_COMBO(ldr,   &leader,      LM2 LM1,     DEF)
//ZMK_COMBO(ldrsh, &leader_sft,  LM3 LM2 LM1, DEF)
