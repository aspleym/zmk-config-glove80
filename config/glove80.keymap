/*
 * Copyright (c) 2020 The ZMK Contributors
 *
 * SPDX-License-Identifier: MIT
 */
#include <behaviors.dtsi>
#include <dt-bindings/zmk/keys.h>
#include <dt-bindings/zmk/bt.h>
#include <dt-bindings/zmk/ext_power.h>
#include <dt-bindings/zmk/outputs.h>
#include <dt-bindings/zmk/rgb.h>

#include "keys_nb.h"
#include "zmk-helpers/include/zmk-helpers/helper.h"
#include "zmk-helpers/include/zmk-helpers/key-labels/glove80.h"

#define HYPER LC(LS(LG(LALT)))

//
// Layer definitions
///
#define DEFAULT 0

// LAYER TOGGLES
#define MOUSE_S 1
#define MOUSE_F 2
#define GAMING 3

// Hold to activate layers
#define SYMBOL 4
#define SPECIAL 5

#define EXP 6
#define FREE7 7

// FACTORY
#define MAGIC 8
#define FACTORY_TEST 9

#define xxx &none
#define ___ &trans


/*                               GLOVE80 KEY MATRIX / LAYOUT MAPPING
 ╭────────────────────╮       ╭────────────────────╮ ╭────────────────────╮       ╭────────────────────╮
 │  0   1   2   3   4 ╰───┬───╯  5   6   7   8   9 │ │ LC5 LC4 LC3 LC2 LC1╰───┬───╯ RC1 RC2 RC3 RC4 RC5│
 │ 10  11  12  13  14  15 │ 16  17  18  19  20  21 │ │ LN5 LN4 LN3 LN2 LN1 LN0│ RN0 RN1 RN2 RN3 RN4 RN5│
 │ 22  23  24  25  26  27 │ 28  29  30  31  32  33 │ │ LT5 LT4 LT3 LT2 LT1 LT0│ RT0 RT1 RT2 RT3 RT4 RT5│
 │ 34  35  36  37  38  39 │ 40  41  42  43  44  45 │ │ LM5 LM4 LM3 LM2 LM1 LM0│ RM0 RM1 RM2 RM3 RM4 RM5│
 │ 46  47  48  49  50  51 │ 58  59  60  61  62  63 │ │ LB5 LB4 LB3 LB2 LB1 LB0│ RB0 RB1 RB2 RB3 RB4 RB5│
 │ 64  65  66  67  68 ╭───┴───╮ 75  76  77  78  79 │ │ LF5 LF4 LF3 LF2 LF1╭───┴───╮ RF1 RF2 RF3 RF4 RF5│
 ╰───────────┬────────┴───┬───┴────────┬───────────╯ ╰───────────┬────────┴───┬───┴────────┬───────────╯
             │ 52  53  54 │ 55  56  57 │                         │ LH5 LH4 LH3│ RH3 RH4 RH5│
             │ 69  70  71 │ 72  73  74 │                         │ LH2 LH1 LH0│ RH0 RH1 RH2│
             ╰────────────┴────────────╯                         ╰────────────┴────────────╯
 */

#define KEYS_L LC1 LC2 LC3 LC4 LC5 LN0 LN1 LN2 LN3 LN4 LN5 LT0 LT1 LT2 LT3 LT4 LT5 LM0 LM1 LM2 LM3 LM4 LM5 LB0 LB1 LB2 LB3 LB4 LB5 LF1 LF2 LF3 LF4 LF5
#define KEYS_R RC1 RC2 RC3 RC4 RC5 RN0 RN1 RN2 RN2 RN3 RN4 RN5 RT0 RT1 RT2 RT3 RT4 RT5 RM0 RM1 RM2 RM3 RM4 RM5 RB0 RB1 RB2 RB3 RB4 RB5 RF1 RF2 RF3 RF4 RF5
#define THUMBS LH5 LH4 LH3 LH2 LH1 LH0 RH0 RH1 RH2 RH3 RH4 RH5

#define TAPPING_TERM_MS 280 // 170
#define QUICK_TAP_MS  175 //160
#define PRIOR_IDLE_MS 150 // 75

// Some key press behaviors
&sk {
  release-after-ms = <900>;
  quick-release;
};

&sl { // Allow sticky mods to chord across sticky layers.
  ignore-modifiers;
};

&lt {
  flavor = "balanced";
  tapping-term-ms = <200>;
  quick-tap-ms = <QUICK_TAP_MS>;
};


#define MAKE_HRM(NAME, HOLD, TAP, TRIGGER_POS)                                 \
  ZMK_HOLD_TAP(NAME, bindings = <HOLD>, <TAP>; flavor = "balanced";            \
               tapping-term-ms = <TAPPING_TERM_MS>; quick-tap-ms = <QUICK_TAP_MS>;         \
               require-prior-idle-ms = <PRIOR_IDLE_MS>; hold-trigger-on-release;         \
               hold-trigger-key-positions = <TRIGGER_POS>;)

MAKE_HRM(hml, &kp, &kp, KEYS_R THUMBS) // Left-hand HRMs.
MAKE_HRM(hmr, &kp, &kp, KEYS_L THUMBS) // Right-hand HRMs.

// Include dtsis
#include "mouse.dtsi"

//
// Smart functions
//
&caps_word {  // mods deactivate caps-word, requires PR #1450
    /delete-property/ ignore-modifiers;
};

// Magic hold tap
ZMK_HOLD_TAP(
    magic,
    flavor = "tap-preferred";
    tapping-term-ms = <200>;
    bindings = <&mo>, <&rgb_ug_status_macro>;
)

// Backspace -> Shift + BS = Delete
ZMK_MOD_MORPH(
    bs_del,
    bindings = <&kp BACKSPACE>, <&kp DELETE>;
    mods = <(MOD_LSFT|MOD_RSFT)>;
)

// Smart shift
ZMK_MOD_MORPH(
    smart_shft,
    bindings = <&sk LSHFT>, <&caps_word>;
    mods = <(MOD_LSFT)>;
)

ZMK_TAP_DANCE(
    ld,
    bindings = <&to MOUSE_S>, <&to GAMING>;
    tapping-term-ms = <200>;
)

ZMK_HOLD_TAP(
    l_mod,
    flavor = "tap-preferred";
    tapping-term-ms = <250>;
    quick-tap-ms = <200>;
    bindings = <&mo>, <&ld>;
)

//
// PROGRAMMING ROW
//

ZMK_MOD_MORPH(
    dgrave,
    bindings = <&kp DLLR>, <&kp GRAVE>;
    mods = <(MOD_LSFT|MOD_RSFT)>;
)

ZMK_MOD_MORPH(
    apipe,
    bindings = <&kp AMPS>, <&kp PIPE>;
    mods = <(MOD_LSFT|MOD_RSFT)>;
)

ZMK_MOD_MORPH(
    starslh,
    bindings = <&kp STAR>, <&kp BSLH>;
    mods = <(MOD_LSFT|MOD_RSFT)>;
)

ZMK_MOD_MORPH(
    pu11,
    bindings = <&kp PG_UP>, <&kp F11>;
    mods = <(MOD_LSFT|MOD_RSFT)>;
)

ZMK_MOD_MORPH(
    pd12,
    bindings = <&kp PG_DN>, <&kp F12>;
    mods = <(MOD_LSFT|MOD_RSFT)>;
)

//
// NUM FUN MORPH
//
ZMK_MOD_MORPH(
    nf1,
    bindings = <&kp N1>, <&kp F1>;
    mods = <(MOD_LSFT|MOD_RSFT)>;
)

ZMK_MOD_MORPH(
    nf2,
    bindings = <&kp N2>, <&kp F2>;
    mods = <(MOD_LSFT|MOD_RSFT)>;
)

ZMK_MOD_MORPH(
    nf3,
    bindings = <&kp N3>, <&kp F3>;
    mods = <(MOD_LSFT|MOD_RSFT)>;
)

ZMK_MOD_MORPH(
    nf4,
    bindings = <&kp N4>, <&kp F4>;
    mods = <(MOD_LSFT|MOD_RSFT)>;
)

ZMK_MOD_MORPH(
    nf5,
    bindings = <&kp N5>, <&kp F5>;
    mods = <(MOD_LSFT|MOD_RSFT)>;
)

ZMK_MOD_MORPH(
    nf6,
    bindings = <&kp N6>, <&kp F6>;
    mods = <(MOD_LSFT|MOD_RSFT)>;
)

ZMK_MOD_MORPH(
    nf7,
    bindings = <&kp N7>, <&kp F7>;
    mods = <(MOD_LSFT|MOD_RSFT)>;
)

ZMK_MOD_MORPH(
    nf8,
    bindings = <&kp N8>, <&kp F8>;
    mods = <(MOD_LSFT|MOD_RSFT)>;
)

ZMK_MOD_MORPH(
    nf9,
    bindings = <&kp N9>, <&kp F9>;
    mods = <(MOD_LSFT|MOD_RSFT)>;
)

ZMK_MOD_MORPH(
    nf0,
    bindings = <&kp N0>, <&kp F10>;
    mods = <(MOD_LSFT|MOD_RSFT)>;
)



/ {
    macros {
        rgb_ug_status_macro: rgb_ug_status_macro_0 {
            compatible = "zmk,behavior-macro";
            #binding-cells = <0>;
            bindings
                = <&rgb_ug RGB_STATUS>;
        };

        bt_0: bt_profile_macro_0 {
            compatible = "zmk,behavior-macro";
            #binding-cells = <0>;
            bindings
                = <&out OUT_BLE>,
                  <&bt BT_SEL 0>;
        };

        bt_1: bt_profile_macro_1 {
            compatible = "zmk,behavior-macro";
            #binding-cells = <0>;
            bindings
                = <&out OUT_BLE>,
                  <&bt BT_SEL 1>;
        };

        bt_2: bt_profile_macro_2 {
            compatible = "zmk,behavior-macro";
            #binding-cells = <0>;
            bindings
                = <&out OUT_BLE>,
                  <&bt BT_SEL 2>;
        };

        bt_3: bt_profile_macro_3 {
            compatible = "zmk,behavior-macro";
            #binding-cells = <0>;
            bindings
                = <&out OUT_BLE>,
                  <&bt BT_SEL 3>;
        };
    };

    keymap {
        compatible = "zmk,keymap";

        default_layer {
            bindings = <
            &kp F1            &kp F2            &kp F3            &kp F4            &kp F5                                                                                                                                    &kp F6            &kp F7            &kp F8            &kp F9            &kp F10
            &kp F11           &kp N1            &kp N2            &kp N3            &kp N4            &kp N5                                                                                                &kp N6            &kp N7            &kp N8            &kp N9            &kp N0            &kp F12
            &kp MINUS         &kp Q             &kp W             &kp F             &kp P             &kp B                                                                                                 &kp J             &kp L             &kp U             &kp Y             &kp SEMI          &kp BSLH
            &kp EQUAL         &kp A             &kp R             &kp S             &kp T             &kp G                                                                                                 &kp M             &kp N             &kp E             &kp I             &kp O             &kp SQT
            &kp GRAVE         &hml LGUI Z       &hml LALT X       &hml LCTRL C      &hml LSHFT D      &kp V             &kp LCTRL  &kp LALT    &l_mod SPECIAL 0     &kp LGUI    &kp RCTRL   &kp TAB         &kp K             &hmr RSHFT H      &hmr RCTRL COMMA  &hmr LALT DOT     &hmr RGUI FSLH    &kp PG_UP
            &magic MAGIC 0    &kp HOME          &kp END           &kp LBKT          &kp RBKT                            &bs_del  &lt SYMBOL ESC &smart_shft         &kp RALT    &kp RET     &kp SPACE                         &kp LEFT          &kp DOWN          &kp UP            &kp RIGHT         &kp PG_DN
            >;
        };


        // Toggle layers
        mouse_slow_layer {
            bindings = <
            xxx               xxx               xxx               xxx               xxx                                                                                                                                       xxx               xxx               xxx               xxx               xxx                    
            xxx               xxx               xxx               xxx               xxx               xxx                                                                                                   xxx               xxx               xxx               xxx               xxx               xxx 
            xxx               xxx               xxx               xxx               xxx               xxx                                                                                                   &kp PG_UP         U_WH_U            U_MS_U            U_WH_D            &kp PG_DN         xxx  
            xxx               xxx               xxx               xxx               xxx               xxx                                                                                                   U_WH_L            U_MS_L            U_MS_D            U_MS_R            U_WH_R            xxx
            xxx               xxx               xxx               xxx               xxx               xxx         &lt MOUSE_F ESC   xxx     &to DEFAULT             xxx         xxx         &mkp RCLK       xxx               &mkp LCLK         &mkp MCLK         &mkp RCLK         xxx               xxx
            ___               xxx               xxx               xxx               xxx                                 xxx         xxx         xxx                 xxx         xxx         &mkp LCLK                         xxx               xxx               xxx               xxx               xxx               
            >;
        };

        mouse_fast_layer {
            bindings = <
            ___               ___               ___               ___               ___                                                                                                                                       ___               ___               ___               ___               ___                    
            ___               ___               ___               ___               ___               ___                                                                                                   ___               ___               ___               ___               ___               ___ 
            ___               ___               ___               ___               ___               ___                                                                                                   ___               ___               ___               ___               ___               ___  
            ___               ___               ___               ___               ___               ___                                                                                                   ___               ___               ___               ___               ___               ___ 
            ___               ___               ___               ___               ___               ___               ___         ___         ___                 ___         ___         ___             ___               ___               ___               ___               ___               ___ 
            ___               ___               ___               ___               ___                                 ___         ___         ___                 ___         ___         ___                               ___               ___               ___               ___               ___               
            >;
        };

        gaming_layer {
            bindings = <
            &kp ESC           &kp P             &kp O             &kp N             &kp B                                                                                                                                     &kp F1            &kp F2            &kp F3            &kp F4            &kp F5                    
            &kp M             &kp N6            &kp N7            &kp N8            &kp N9            &kp N0                                                                                                &kp F6            &kp F7            &kp F8            &kp F9            &kp F10           &kp F11 
            &kp I             &kp N1            &kp N2            &kp N3            &kp N4            &kp N5                                                                                                &kp Y             &kp U             &kp I             &kp O             &kp P             &kp F12  
            &kp T             &kp TAB           &kp Q             &kp W             &kp E             &kp R                                                                                                 &kp H             &kp J             &kp K             &kp L             &kp SEMI          &kp SQT 
            &kp G             &kp LSHFT         &kp A             &kp S             &kp D             &kp F             xxx         xxx     &to EXP                 xxx         xxx         &kp TAB         &kp N             &kp M             &kp COMMA         &kp DOT           &kp FSLH          &kp BSLH 
            ___               &kp LCTRL         &kp Z             &kp X             &kp C                               &kp SPACE   &bs_del   xxx                   xxx         &kp RET     &kp SPACE                         &kp MINUS         &kp LBKT          &kp RBKT          &kp EQUAL         &kp GRAVE
            >;
        };


        // Hold to trigger layers
        symbol_layer {
            bindings = <
            xxx               xxx               xxx               xxx               xxx                                                                                                                                       xxx               xxx               xxx               xxx               xxx                    
            xxx               xxx               xxx               xxx               xxx               xxx                                                                                                   xxx               xxx               xxx               xxx               xxx               xxx 
            xxx               xxx               xxx               xxx               xxx               xxx                                                                                                   xxx               xxx               xxx               &kp RA(Q)         xxx               xxx  
            xxx               xxx               xxx               xxx               &kp LSHFT         xxx                                                                                                   xxx               xxx               xxx               &kp RA(T)         &kp RA(W)         xxx 
            xxx               xxx               xxx               xxx               xxx               xxx               xxx         xxx         xxx                 xxx         xxx         xxx             xxx               xxx               xxx               xxx               xxx               xxx 
            xxx               xxx               xxx               xxx               xxx                                 xxx         xxx         xxx                 xxx         xxx         xxx                               xxx               xxx               xxx               xxx               xxx               
            >;
        };

        special_layer {
            bindings = <
            ___               ___               ___               ___               ___                                                                                                                                       ___               ___               ___               ___               ___                    
            ___               ___               ___               ___               ___               ___                                                                                                   ___               ___               ___               ___               ___               ___ 
            ___               ___               ___               ___               ___               ___                                                                                                   &kp C_MUTE        &kp C_VOL_DN      &kp C_VOL_UP      ___               ___               ___  
            ___               ___               ___               ___               ___               ___                                                                                                   ___               &kp C_PP          &kp C_PREV        &kp C_NEXT        ___               ___ 
            ___               ___               ___               ___               ___               ___               ___         ___         ___                 ___         ___         ___             ___               ___               ___               ___               ___               ___ 
            ___               ___               ___               ___               ___                                 ___         ___         ___                 ___         ___         ___                               ___               ___               ___               ___               ___               
            >;
        };

        exp_layer {
            bindings = <
            &nf1              &nf2              &nf3              &nf4              &nf5                                                                                                                                      &nf6              &nf7              &nf8              &nf9              &nf0  
            &dgrave           &kp PLUS          &kp LBKT          &kp LBRC          &kp LPAR          &apipe                                                                                                &kp EQUAL         &kp RPAR          &kp RBRC          &kp RBKT          &starslh          &kp EXCL
            &kp TAB           &kp Q             &kp W             &kp F             &kp P             &kp B                                                                                                 &kp J             &kp L             &kp U             &kp Y             &kp SEMI          &kp MINUS
            &kp ESC           &hml LGUI A       &hml LALT R       &hml LCTRL S      &hml LSHFT T      &kp G                                                                                                 &kp M             &hmr RSHFT N      &hmr RCTRL E      &hmr LALT I       &hmr RGUI O       &kp SQT
            &kp GRAVE         &kp Z             &kp X             &kp C             &kp D             &kp V             &smart_shft &kp LCTRL   &to DEFAULT         &kp LGUI    &kp RCTRL   &kp TAB         &kp K             &kp H             &kp COMMA         &kp DOT           &kp FSLH          &pu11
            &magic MAGIC 0    &kp HOME          &kp END           &kp LBKT          &kp RBKT                            &bs_del  &lt SYMBOL ESC &kp LALT            &kp RALT    &kp RET     &kp SPACE                         &kp LEFT          &kp DOWN          &kp UP            &kp RIGHT         &pd12
            >;

        };

        free7_layer {
            bindings = <
            ___               ___               ___               ___               ___                                                                                                                                       ___               ___               ___               ___               ___                    
            ___               ___               ___               ___               ___               ___                                                                                                   ___               ___               ___               ___               ___               ___ 
            ___               ___               ___               ___               ___               ___                                                                                                   ___               ___               ___               ___               ___               ___  
            ___               ___               ___               ___               ___               ___                                                                                                   ___               ___               ___               ___               ___               ___ 
            ___               ___               ___               ___               ___               ___               ___         ___         ___                 ___         ___         ___             ___               ___               ___               ___               ___               ___ 
            ___               ___               ___               ___               ___                                 ___         ___         ___                 ___         ___         ___                               ___               ___               ___               ___               ___               
            >;
        };


        // FACTORY LAYERS
        magic_layer {
            bindings = <
                &bt BT_CLR        xxx                 xxx             xxx             xxx                                                                                                                xxx      xxx      xxx      xxx      &bt BT_CLR_ALL
                xxx               xxx                 xxx             xxx             xxx             xxx                                                                                       xxx      xxx      xxx      xxx      xxx      xxx
                xxx               &rgb_ug RGB_SPI     &rgb_ug RGB_SAI &rgb_ug RGB_HUI &rgb_ug RGB_BRI &rgb_ug RGB_TOG                                                                           xxx      xxx      xxx      xxx      xxx      xxx
                &bootloader       &rgb_ug RGB_SPD     &rgb_ug RGB_SAD &rgb_ug RGB_HUD &rgb_ug RGB_BRD &rgb_ug RGB_EFF                                                                           xxx      xxx      xxx      xxx      xxx      &bootloader
                &sys_reset        xxx                 xxx             xxx             xxx             xxx                       &bt_2     &bt_3     xxx              xxx     xxx     xxx        xxx      xxx      xxx      xxx      xxx      &sys_reset
                xxx               xxx                 xxx             xxx             xxx                                       &bt_0     &bt_1  &out OUT_USB        xxx     xxx     xxx                 xxx      xxx      xxx      xxx      &to FACTORY_TEST
            >;
        };

        factory_test_layer {
            bindings = <
                &kp N0   &kp N6   &kp N2   &kp N8   &kp N4                                                                              &kp N4   &kp N8   &kp N2   &kp N6   &kp N0
                &kp N1   &kp N7   &kp N3   &kp N9   &kp N5   &kp N0                                                            &kp N0   &kp N5   &kp N9   &kp N3   &kp N7   &kp N1
                &kp N2   &kp N8   &kp N4   &kp N0   &kp N6   &kp N1                                                            &kp N1   &kp N6   &kp N0   &kp N4   &kp N8   &kp N2
                &kp N3   &kp N9   &kp N5   &kp N1   &kp N7   &kp N2                                                            &kp N2   &kp N7   &kp N1   &kp N5   &kp N9   &kp N3
                &kp N4   &kp N0   &kp N6   &kp N2   &kp N8   &kp N3   &kp N4   &kp N5   &kp N6      &kp N6   &kp N5   &kp N4   &kp N3   &kp N8   &kp N2   &kp N6   &kp N0   &kp N4
                &kp N5   &kp N1   &kp N7   &kp N3   &kp N9            &kp N7   &kp N8   &kp N9      &kp N9   &kp N8   &kp N7            &kp N9   &kp N3   &kp N7   &kp N1   &kp N5
            >;
        };

        // TEMPLATE LAYERS

        none_layout_template {
            bindings = <
            xxx               xxx               xxx               xxx               xxx                                                                                                                                       xxx               xxx               xxx               xxx               xxx                    
            xxx               xxx               xxx               xxx               xxx               xxx                                                                                                   xxx               xxx               xxx               xxx               xxx               xxx 
            xxx               xxx               xxx               xxx               xxx               xxx                                                                                                   xxx               xxx               xxx               xxx               xxx               xxx  
            xxx               xxx               xxx               xxx               xxx               xxx                                                                                                   xxx               xxx               xxx               xxx               xxx               xxx 
            xxx               xxx               xxx               xxx               xxx               xxx               xxx         xxx         xxx                 xxx         xxx         xxx             xxx               xxx               xxx               xxx               xxx               xxx 
            xxx               xxx               xxx               xxx               xxx                                 xxx         xxx         xxx                 xxx         xxx         xxx                               xxx               xxx               xxx               xxx               xxx               
            >;
        };

        trans_layout_template {
            bindings = <
            ___               ___               ___               ___               ___                                                                                                                                       ___               ___               ___               ___               ___                    
            ___               ___               ___               ___               ___               ___                                                                                                   ___               ___               ___               ___               ___               ___ 
            ___               ___               ___               ___               ___               ___                                                                                                   ___               ___               ___               ___               ___               ___  
            ___               ___               ___               ___               ___               ___                                                                                                   ___               ___               ___               ___               ___               ___ 
            ___               ___               ___               ___               ___               ___               ___         ___         ___                 ___         ___         ___             ___               ___               ___               ___               ___               ___ 
            ___               ___               ___               ___               ___                                 ___         ___         ___                 ___         ___         ___                               ___               ___               ___               ___               ___               
            >;
        };
    };
};


/* special_layer { */
/*     bindings = < */
/*         &kp C_BRI_DN      &kp C_BRI_UP        &kp C_PREV      &kp C_NEXT      &kp C_PP                                                                                                         &kp C_MUTE   &kp C_VOL_DN &kp C_VOL_UP  xxx             &kp PAUSE_BREAK */
/*         xxx               xxx                 xxx             xxx             xxx             &kp HOME                                                                            &kp LPAR     &kp KP_NUM   &kp KP_EQUAL &kp KP_DIVIDE &kp KP_MULTIPLY &kp PSCRN */
/*         ___               xxx                 xxx             &kp UP          xxx             &kp END                                                                             &kp RPAR     &kp KP_N7    &kp KP_N8    &kp KP_N9     &kp KP_MINUS    &kp SLCK */
/*         ___               xxx                 &kp LEFT        &kp DOWN        &kp RIGHT       &kp PG_UP                                                                           &kp PRCNT    &kp KP_N4    &kp KP_N5    &kp KP_N6     &kp KP_PLUS     xxx */
/*         ___               &kp K_CMENU         xxx             &kp F11         &kp F12         &kp PG_DN             ___      ___  &to MOUSE_S  ___      ___      ___              &kp COMMA    &kp KP_N1    &kp KP_N2    &kp KP_N3     &kp KP_ENTER    ___ */
/*         ___               &kp CAPS            &kp INS         &kp F11         &kp F12                               ___      ___      ___      ___      ___      ___                           &kp KP_N0    &kp KP_N0    &kp KP_DOT    &kp KP_ENTER    ___ */
/*     >; */
/* }; */
